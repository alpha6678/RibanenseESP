## firmware/apps/Calculadora/sdkconfig.defaults
```kconfig
CONFIG_ESPTOOLPY_FLASHSIZE_4MB=y
CONFIG_PARTITION_TABLE_CUSTOM=y
CONFIG_PARTITION_TABLE_CUSTOM_FILENAME="partitions_4mb_two_ota.csv"
CONFIG_ESP_DEFAULT_CPU_FREQ_MHZ_240=y
CONFIG_ESP_MAIN_TASK_STACK_SIZE=16384
CONFIG_FREERTOS_HZ=1000
CONFIG_ESP_TASK_WDT_TIMEOUT_S=15
CONFIG_ESP_SYSTEM_EVENT_TASK_STACK_SIZE=4096
CONFIG_LV_MEM_SIZE=49152
CONFIG_LV_MEM_SIZE_KILOBYTES=48
CONFIG_BOOTLOADER_APP_ROLLBACK_ENABLE=y
CONFIG_FATFS_LFN_HEAP=y
CONFIG_LV_CONF_SKIP=y
CONFIG_LV_COLOR_DEPTH=16
CONFIG_LV_COLOR_DEPTH_16=y
CONFIG_LV_DEF_REFR_PERIOD=33
CONFIG_LV_USE_THEME_SIMPLE=y
CONFIG_LV_USE_THEME_DEFAULT=n
CONFIG_LV_USE_KEYBOARD=y
CONFIG_LV_USE_TEXTAREA=y
CONFIG_LV_USE_BUTTONMATRIX=y
CONFIG_LV_USE_SWITCH=n
CONFIG_LV_USE_BAR=y
CONFIG_LV_USE_CHECKBOX=n
CONFIG_LV_USE_LABEL=y
CONFIG_LV_USE_BUTTON=y
CONFIG_LV_USE_FLEX=y
CONFIG_LV_USE_IMAGE=y
CONFIG_LV_FONT_MONTSERRAT_14=y
CONFIG_LV_FONT_DEFAULT_MONTSERRAT_14=y
CONFIG_LV_FONT_MONTSERRAT_24=y
CONFIG_LV_USE_LOG=n
CONFIG_LV_USE_SYSMON=n
CONFIG_LV_USE_SNAPSHOT=n
CONFIG_LV_USE_MONKEY=n
CONFIG_LV_USE_GRIDNAV=n
CONFIG_LV_USE_IMGFONT=n
CONFIG_LV_BUILD_EXAMPLES=n
CONFIG_LV_BUILD_DEMOS=n
```

## firmware/apps/Sobre/sdkconfig.defaults
```kconfig
CONFIG_ESPTOOLPY_FLASHSIZE_4MB=y
CONFIG_PARTITION_TABLE_CUSTOM=y
CONFIG_PARTITION_TABLE_CUSTOM_FILENAME="partitions_4mb_two_ota.csv"
CONFIG_ESP_DEFAULT_CPU_FREQ_MHZ_240=y
CONFIG_ESP_MAIN_TASK_STACK_SIZE=16384
CONFIG_FREERTOS_HZ=1000
CONFIG_ESP_TASK_WDT_TIMEOUT_S=15
CONFIG_ESP_SYSTEM_EVENT_TASK_STACK_SIZE=4096

CONFIG_LV_CONF_SKIP=y
CONFIG_LV_COLOR_DEPTH=16
CONFIG_LV_COLOR_DEPTH_16=y
CONFIG_LV_DEF_REFR_PERIOD=333
CONFIG_LV_USE_THEME_SIMPLE=y
CONFIG_LV_USE_THEME_DEFAULT=n
CONFIG_LV_USE_LABEL=y
CONFIG_LV_USE_BUTTON=y
CONFIG_LV_USE_FLEX=y
CONFIG_LV_FONT_MONTSERRAT_14=y
CONFIG_LV_FONT_DEFAULT_MONTSERRAT_14=y
CONFIG_LV_USE_LOG=n
CONFIG_LV_BUILD_EXAMPLES=n
CONFIG_LV_BUILD_DEMOS=n
```
